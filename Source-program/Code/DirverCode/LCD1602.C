/* *******************************************************************************************
// Author:      biu~
// Last Date:   2018/03/22
// Keil工程第一个Tab设置填充空格的
/* ******************************************************************************************* */
#include "LCD1602.H"

#define LCD_DATAPIN P2      //并口数据传输；

sbit LCD1602_RS = P3^1;
sbit LCD1602_RW = P3^2;
sbit LCD1602_E  = P3^3;
/* *******************************************************************************************
// 向LCD1602写一字节命令
/* ******************************************************************************************* */
static void writeCommand(u8 command)
{
    LCD1602_RS = 0;
    LCD1602_RW = 0;
    LCD_DATAPIN = command;
    LCD1602_E = 1;	
    DelayMS(1);             //等待接收，省略了读状态操作；
    LCD1602_E = 0;
    LCD1602_RW = 1;
}

/* *******************************************************************************************
// 向LCD1602写一字节数据
/* ******************************************************************************************* */
void WriteOneData(u8 dat)
{
    LCD1602_RW = 0;
    LCD1602_RS = 1; 	
    LCD_DATAPIN = dat;
    LCD1602_E = 1;
    DelayMS(1);             //等待接收，省略了读状态操作；
    LCD1602_E = 0;
    LCD1602_RW = 1;
}

/* *******************************************************************************************
// 初始化LCD1602
/* ******************************************************************************************* */
void LCD1602_Init()
{
    writeCommand(0x38);     //两行，每行16字符，每个字符5*7点阵；
    writeCommand(0x0f);     //光标显示并闪烁；
    writeCommand(0x0C);     //光标不显示；
    writeCommand(0x06);     //光标随字符右移；
}

/* *******************************************************************************************
// LCD1602清屏
/* ******************************************************************************************* */
void LCD1602_Clear()
{
    writeCommand(0x01);	
    writeCommand(0x02);	
}

/* *******************************************************************************************
// 向LCD1602写字符串
/* ******************************************************************************************* */
void LCD1602_DisString(u8 *chr)
{
    while (*chr)            //字符非空；
    {
        WriteOneData(*chr);    //写字符；
        chr++;		        //数据指针加1；
    }
}
/* *******************************************************************************************
// 向LCD1602写数字量(两位)
/* ******************************************************************************************* */
void LCD1602_DisNum(u8 two_digits_num)
{
//    u8 num[] = "0123456789";
//    if (two_digits_num > 100)
//    {
//        two_digits_num %= 100;
//    }
//    writeData(num[two_digits_num / 10]);
//    writeData(num[two_digits_num % 10]);	
    if (two_digits_num > 100)
    {
        two_digits_num %= 100;
    }
    WriteOneData(two_digits_num / 10 + '0');
    WriteOneData(two_digits_num % 10 + '0');	
}
/* *******************************************************************************************
// 设置LCD1602坐标
/* ******************************************************************************************* */
void LCD1602_GoTo_yx(u8 y, u8 x)
{
    switch (y)
    {
        case 1: writeCommand(0x80 + x);         //第一行
            break;
        case 2: writeCommand(0x80 + 0x40 + x);  //第二行
            break;
        default:
            break;
    }
}